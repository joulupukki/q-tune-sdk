## examples/example_standby/sdkconfig.defaults
```kconfig
# sdkconfig.defaults — example_standby plugin
#
# Mirrors the firmware's LVGL configuration so that struct layouts match.
# See example_tuner/sdkconfig.defaults for full commentary.

# --- Color depth: 16-bit RGB565 — MANDATORY, must match firmware ----------
CONFIG_LV_COLOR_DEPTH_16=y
CONFIG_LV_COLOR_DEPTH=16

# --- OS integration -------------------------------------------------------
CONFIG_LV_OS_FREERTOS=y
CONFIG_LV_USE_OS=2

# --- Memory management ----------------------------------------------------
CONFIG_LV_USE_CLIB_MALLOC=y
CONFIG_LV_USE_BUILTIN_STRING=y
CONFIG_LV_USE_CLIB_SPRINTF=y

# --- Widgets used by this example -----------------------------------------
# The bouncing dot is a plain lv_obj — no special widget feature flags needed.
# lv_timer is always available.

# --- Shared object support ------------------------------------------------
CONFIG_ELF_DYNAMIC_LOAD_SHARED_OBJECT=y
```

## plugins/standby/jamagotchi/sdkconfig.defaults
```kconfig
# sdkconfig.defaults — Jamagotchi standby plugin
#
# These mirror the firmware's LVGL configuration so the compiled .so shares the
# same struct layouts as the firmware. DO NOT change CONFIG_LV_COLOR_DEPTH.

# --- Color depth: 16-bit RGB565 — MANDATORY, must match firmware ----------
CONFIG_LV_COLOR_DEPTH_16=y
CONFIG_LV_COLOR_DEPTH=16

# --- OS integration: FreeRTOS ---------------------------------------------
CONFIG_LV_OS_FREERTOS=y
CONFIG_LV_USE_OS=2

# --- Memory management ----------------------------------------------------
CONFIG_LV_USE_CLIB_MALLOC=y
CONFIG_LV_USE_BUILTIN_STRING=y
CONFIG_LV_USE_CLIB_SPRINTF=y

# --- Widgets / fonts: enable what your plugin uses ------------------------
# Jamagotchi draws the pet/UI from labels + plain lv_obj primitives (no images).
# Fonts: 14 (stats), 18 (headers/buttons), 28 (echo tiles), 40 (pad/notes), 48 (big note).
CONFIG_LV_USE_LABEL=y
CONFIG_LV_FONT_MONTSERRAT_14=y
CONFIG_LV_FONT_MONTSERRAT_18=y
CONFIG_LV_FONT_MONTSERRAT_28=y
CONFIG_LV_FONT_MONTSERRAT_40=y
CONFIG_LV_FONT_MONTSERRAT_48=y

# --- Shared object support (required) -------------------------------------
CONFIG_ELF_DYNAMIC_LOAD_SHARED_OBJECT=y
```

## plugins/tuner/gauge/sdkconfig.defaults
```kconfig
# sdkconfig.defaults — gauge plugin
#
# These settings mirror the firmware's LVGL configuration so that the compiled
# .so shares the same struct layouts and symbol sizes as the firmware binary.
# The loader rejects a plugin whose LVGL major.minor does not match the firmware,
# so DO NOT change CONFIG_LV_COLOR_DEPTH or any struct-layout-affecting option.
#
# This file is consumed by `idf.py build` (via menuconfig defaults). Only the
# settings relevant to the plugin build are listed; everything else uses the
# IDF/LVGL component defaults.

# --- LVGL version lock (must match firmware: 9.2.2) -----------------------
# (Enforced by idf_component.yml pinning lvgl/lvgl to ==9.2.2)

# --- Color depth: 16-bit RGB565 — MANDATORY, must match firmware ----------
CONFIG_LV_COLOR_DEPTH_16=y
CONFIG_LV_COLOR_DEPTH=16

# --- OS integration: FreeRTOS ---------------------------------------------
CONFIG_LV_OS_FREERTOS=y
CONFIG_LV_USE_OS=2

# --- Memory management ----------------------------------------------------
CONFIG_LV_USE_CLIB_MALLOC=y
CONFIG_LV_USE_BUILTIN_STRING=y
CONFIG_LV_USE_CLIB_SPRINTF=y

# --- Widgets used by this example -----------------------------------------
CONFIG_LV_USE_LABEL=y
CONFIG_LV_USE_ARC=y

# --- Fonts used by this example -------------------------------------------
# Montserrat 14 is the minimum (used by the ref-freq label).
# Montserrat 48 is used by the main note-name label.
# If the firmware is built without 48pt, fall back to 28pt and update the
# source accordingly.
CONFIG_LV_FONT_MONTSERRAT_14=y
CONFIG_LV_FONT_MONTSERRAT_48=y
CONFIG_LV_FONT_DEFAULT_MONTSERRAT_18=y

# --- Shared object support (required by project_so macro) -----------------
CONFIG_ELF_DYNAMIC_LOAD_SHARED_OBJECT=y
```

## plugins/tuner/phase/sdkconfig.defaults
```kconfig
# sdkconfig.defaults — Strobe tuner plugin
#
# Mirrors the firmware's LVGL configuration so the compiled .so shares struct
# layouts with the firmware. DO NOT change CONFIG_LV_COLOR_DEPTH.

# --- Color depth: 16-bit RGB565 — MANDATORY, must match firmware ----------
CONFIG_LV_COLOR_DEPTH_16=y
CONFIG_LV_COLOR_DEPTH=16

# --- OS integration: FreeRTOS ---------------------------------------------
CONFIG_LV_OS_FREERTOS=y
CONFIG_LV_USE_OS=2

# --- Memory management ----------------------------------------------------
CONFIG_LV_USE_CLIB_MALLOC=y
CONFIG_LV_USE_BUILTIN_STRING=y
CONFIG_LV_USE_CLIB_SPRINTF=y

# --- Widgets / fonts used by this plugin ----------------------------------
CONFIG_LV_USE_LABEL=y
CONFIG_LV_USE_IMAGE=y
CONFIG_LV_FONT_MONTSERRAT_14=y
CONFIG_LV_FONT_MONTSERRAT_24=y
CONFIG_LV_FONT_DEFAULT_MONTSERRAT_14=y

# --- Shared object support (required) -------------------------------------
CONFIG_ELF_DYNAMIC_LOAD_SHARED_OBJECT=y
```

## template/standby/sdkconfig.defaults
```kconfig
# sdkconfig.defaults — @DISPLAY_NAME@ standby plugin
#
# These mirror the firmware's LVGL configuration so the compiled .so shares the
# same struct layouts as the firmware. DO NOT change CONFIG_LV_COLOR_DEPTH.

# --- Color depth: 16-bit RGB565 — MANDATORY, must match firmware ----------
CONFIG_LV_COLOR_DEPTH_16=y
CONFIG_LV_COLOR_DEPTH=16

# --- OS integration: FreeRTOS ---------------------------------------------
CONFIG_LV_OS_FREERTOS=y
CONFIG_LV_USE_OS=2

# --- Memory management ----------------------------------------------------
CONFIG_LV_USE_CLIB_MALLOC=y
CONFIG_LV_USE_BUILTIN_STRING=y
CONFIG_LV_USE_CLIB_SPRINTF=y

# --- Widgets / fonts: enable what your plugin uses ------------------------
# The starter uses a label and a plain lv_obj. Add more as you use more widgets.
CONFIG_LV_USE_LABEL=y
CONFIG_LV_FONT_MONTSERRAT_28=y

# --- Shared object support (required) -------------------------------------
CONFIG_ELF_DYNAMIC_LOAD_SHARED_OBJECT=y
```

## template/tuner/sdkconfig.defaults
```kconfig
# sdkconfig.defaults — @DISPLAY_NAME@ tuner plugin
#
# These mirror the firmware's LVGL configuration so the compiled .so shares the
# same struct layouts as the firmware. DO NOT change CONFIG_LV_COLOR_DEPTH.

# --- Color depth: 16-bit RGB565 — MANDATORY, must match firmware ----------
CONFIG_LV_COLOR_DEPTH_16=y
CONFIG_LV_COLOR_DEPTH=16

# --- OS integration: FreeRTOS ---------------------------------------------
CONFIG_LV_OS_FREERTOS=y
CONFIG_LV_USE_OS=2

# --- Memory management ----------------------------------------------------
CONFIG_LV_USE_CLIB_MALLOC=y
CONFIG_LV_USE_BUILTIN_STRING=y
CONFIG_LV_USE_CLIB_SPRINTF=y

# --- Widgets / fonts: enable what your plugin uses ------------------------
# The starter code uses a label and the built-in note glyphs. Add more here as
# you use more widgets (e.g. CONFIG_LV_USE_SCALE=y for a needle gauge) or fonts.
CONFIG_LV_USE_LABEL=y
CONFIG_LV_FONT_MONTSERRAT_14=y
CONFIG_LV_FONT_MONTSERRAT_28=y

# --- Shared object support (required) -------------------------------------
CONFIG_ELF_DYNAMIC_LOAD_SHARED_OBJECT=y
```
